## build-mp1/conf/bblayers.conf
```bitbake
# POKY_BBLAYERS_CONF_VERSION is increased each time build/conf/bblayers.conf
# changes incompatibly
POKY_BBLAYERS_CONF_VERSION = "2"

BBPATH = "${TOPDIR}"
BBFILES ?= ""

BBLAYERS ?= " \
  /home/jonathan/Projects/yocto/poky/meta \
  /home/jonathan/Projects/yocto/poky/meta-poky \
  /home/jonathan/Projects/yocto/poky/meta-yocto-bsp \
  /home/jonathan/Projects/yocto/meta-openembedded/meta-oe \ 
  /home/jonathan/Projects/yocto/meta-openembedded/meta-python \
  /home/jonathan/Projects/yocto/meta-python2 \
  /home/jonathan/Projects/yocto/meta-st-stm32mp \
  /home/jonathan/Projects/yocto/meta-st-odyssey \
  /home/jonathan/Projects/yocto/meta-custom \
  "
```
